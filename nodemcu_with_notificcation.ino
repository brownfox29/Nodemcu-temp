// display blynk information on serial monitor output
#define BLYNK_PRINT Serial 

// set up esp, blynk, dht and timer libraries
#include <ESP8266WiFi.h>
#include <BlynkSimpleEsp8266.h>
char auth[] = "5ceefaa2397e40a1b8bee73acc8bea9d"; //insert here your token generated by Blynk

#include <SimpleTimer.h>
SimpleTimer timer;

#include <DHT.h>
#define DHTPIN 2  //dht22 data in d4 of nodemcu 
#define DHTTYPE DHT11
DHT dht(DHTPIN, DHTTYPE);
float h, t; // Values read from sensor
#define pirPin D2 // Input for HC-S501

// create a function called "sendData" and repeat it every x minutes, refer to line 162

void sendData(){

     h = dht.readHumidity();
    
    t = dht.readTemperature();
    // fahrenheit = t * 1.8 + 32.0;
    
    if(isnan(h) || isnan(t)){
      Serial.println("failed to read");
      return;
    }
    
    Blynk.virtualWrite(V11, h);
   
    Blynk.virtualWrite(V10, t);
  
   
   // Blynk.virtualWrite(12,temp_f);
    //delay(300);
    
     

  // print on serial monitor temp and humid values
    Serial.printf("temperature %f",t); //temperature in celsius 
    Serial.println( t );
    Serial.print("humidity %f"); // percentage humidity
    Serial.println( h );



  
  if (t < 5){
  Blynk.email("agarwalmanish149@gmail.com", "ALARM", "Temp is below 5C");
    
   }



  if (t > 40){
  Blynk.email("agarwalmanish149@gmail.com", "ALARM", "Temp is above 40C");  
 
    }



    if (h < 20){
    Blynk.email("agarwalmanish149@gmail.com", "ALARM", "Humid is below 20%"); 

    }

 

   if (h > 90){
    Blynk.email("agarwalmanish149@gmail.com", "ALARM", "Humid is above 90%"); 

    }
  
    

}

void setup(){

  Serial.begin(9600); 

  
  dht.begin();
  
  pinMode(0, OUTPUT);   //yellow LED to test power
  delay(500);

  Blynk.begin(auth, "VIT", "VIT12345"); //insert here your SSID and password

  delay(500);

  Serial.print("device alive, go  to phone app");
    
  delay(500);
  
  // trigger sendData function above every x seconds
  timer.setInterval(4000, sendData);  // 10000 = 10 seconds  (x/1000=seconds)

}


// everything is setup, now the system starts until power off
void loop(){
  
  Blynk.run();
  timer.run();


}


